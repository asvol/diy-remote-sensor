#include "RGBLEDBlender.h"
#include "LedControl.h"
#include "nRF24L01.h"
#include "RF24.h"



// ===========================
//	 		CONFIG
// ===========================

#define SERIAL_SPEED                9600    
#define SERIAL_PRINT_STATE_TIME_MS  2000


#define DISPLAY_DEFAULT_BRIGHTNESS 	15 // 0-15
#define DISPLAY_ITEMS_COUNT 		4 // 1-8 
#define DISPLAY_PIN_DATA_IN 		5 // any digital
#define DISPLAY_PIN_CLK 			7 // any digital
#define DISPLAY_PIN_CS	 			6 // any digital
#define DISPLAY_REFRESH_TIME_MS     2000
#define DISPLAY_TEMPERATURE_TIME_MS 4000         
#define DISPLAY_HUMIDITY_TIME_MS    2000

#define LED_R_PIN                   4 
#define LED_G_PIN                   2 
#define LED_B_PIN                   3 

// we use hardware SPI (MISO - D12, MOSI - D11, SCK - D13)
#define NRF_CE_PIN                  9
#define NRF_CSN_PIN                 10
#define NRF_PA_LEVEL                RF24_PA_HIGH // RF24_PA_LOW
#define NRF_PIPE                    0xE8E8F0F0E1LL // any
#define NRF_CHANNEL                 25 
#define NRF_PIPE_SIZE               1
#define NRF_RECV_TIME_MS            1000
#define MAX_NO_DATA_BEFORE_ERROR    1
#define NRF_RATE                    RF24_250KBPS 

// ===========================
//          GLOBAL STATE
// ===========================

enum RECV_STATE {
  RECV_STATE_ERROR,
  RECV_STATE_SUCCESS,
};

enum TEMPERATURE_STATE {
  TEMPERATURE_STATE_UP,
  TEMPERATURE_STATE_DOWN,
  TEMPERATURE_STATE_NOT_CHANGED,
};

double temperature = 0;
double humidity = 0;
int temperature_state = TEMPERATURE_STATE_NOT_CHANGED;

int recv_success_cnt = 0;
int recv_error_cnt = 0;
int recv_state = RECV_STATE_ERROR;

// ===========================
//          Serial
// ===========================
int serial_time = 1000;


void serial_setup()
{
    Serial.begin(SERIAL_SPEED);
}

void serial_loop(unsigned int delta_time)
{

    serial_time+=delta_time;
    if (serial_time<SERIAL_PRINT_STATE_TIME_MS) return;
    serial_time = 0;

    Serial.print("temperature = '");
    Serial.print(temperature);
    Serial.println("'");

    Serial.print("recv_success_cnt = '");
    Serial.print(recv_success_cnt);
    Serial.println("'");

    Serial.print("recv_error_cnt = '");
    Serial.print(recv_error_cnt);
    Serial.println("'");
  

}


// ===========================
//	 		DISPLAY
// ===========================

// https://goo.gl/eFRDrF
// Constant: font8x8_basic
// Contains an 8x8 font map for unicode points U+0000 - U+007F (basic latin)
char font8x8_basic[128][8] = {
    { 0x00, 0x00, 0x00, 0x00, 0x00, 0x00, 0x00, 0x00},   // U+0000 (nul)
    { 0x00, 0x00, 0x00, 0x00, 0x00, 0x00, 0x00, 0x00},   // U+0001
    { 0x00, 0x00, 0x00, 0x00, 0x00, 0x00, 0x00, 0x00},   // U+0002
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    { 0x00, 0x00, 0x00, 0x00, 0x00, 0x00, 0x00, 0x00}    // U+007F
};

LedControl lc=LedControl(DISPLAY_PIN_DATA_IN,DISPLAY_PIN_CLK,DISPLAY_PIN_CS,DISPLAY_ITEMS_COUNT);

int display_time = 1000;

void display_setup()
{
	int led_count=lc.getDeviceCount();
	for (int i = 0; i < led_count; ++i)
	{
	  	lc.shutdown(i,false);
	  	lc.setIntensity(i,DISPLAY_DEFAULT_BRIGHTNESS);
	  	lc.clearDisplay(i);
	}
}

byte display_reverse_bit(byte x)
{
    int intSize = 8;
    byte y = 0;
    for (int position = 7; position >= 0; position--)
    {
        y += ((x & 1) << position);
        x >>= 1;
    }
    return y;
}

void display_draw_char(int pos, char ch)
{
  for(int i=0;i<8;i++)
  {
    byte x = font8x8_basic[ch][i];
    x = display_reverse_bit(x);
    lc.setRow(pos,i,x);
  }
}

void display_draw_str(char* str)
{
	int led_cnt = lc.getDeviceCount();
	int i=0;
	while(str[i]!='\0' || i>led_cnt)
	{
		display_draw_char(led_cnt-i-1,str[i]);
		++i;
	}
}

enum DISPLAY_STATE_ENUM{
    DISPLAY_TEMPERATURE,
    DISPLAY_HUMIDITY
};

int display_state = DISPLAY_TEMPERATURE;
int state_view = 0;
int current_state_time = 0;
int switch_state_when_time = 0;


void display_loop(unsigned int delta_time)
{
    current_state_time+=delta_time;

    display_time+=delta_time;
    if (display_time<DISPLAY_REFRESH_TIME_MS) return;
    display_time = 0;

    

    if (recv_state == RECV_STATE_ERROR)
    {
        display_draw_str("----");
    }
    else 
    {
        switch (display_state)
        {
            case DISPLAY_TEMPERATURE:
            {
                if (current_state_time >=switch_state_when_time)
                {
                    display_state = DISPLAY_HUMIDITY;
                    current_state_time = 0;
                    switch_state_when_time = DISPLAY_HUMIDITY_TIME_MS;
                }

                int int_temp = temperature;
                char digit[16] = "      /n";
                sprintf(digit,"t%3d",int_temp);
                display_draw_str(digit);
                break;
            }
            case DISPLAY_HUMIDITY:
            {
                if (current_state_time >=switch_state_when_time)
                {
                    display_state = DISPLAY_TEMPERATURE;
                    current_state_time = 0;
                    switch_state_when_time = DISPLAY_TEMPERATURE_TIME_MS;
                }
                
                int int_humidity = humidity;
                char digit_h[16] = "      /n";
                sprintf(digit_h,"H%3d",int_humidity);
                display_draw_str(digit_h);
                break;
            }
        }
            
                
    }
    
    
}

// ===========================
//          LED
// ===========================


RGBLEDBlender my_blender(LED_R_PIN, LED_G_PIN, LED_B_PIN);

unsigned int led_time;
int blend = 0;

void led_setup()
{
    my_blender.TurnOff();
    led_time = 1000;
}


void led_loop(unsigned int delta_time)
{
    led_time+=delta_time;
    if (led_time<300) return;
    led_time = 0;

    if (recv_state == RECV_STATE_SUCCESS)
    {
        my_blender.Hold(_GREEN);
    }
    else
    {
        my_blender.Hold(_RED);
    }
    

}

// ===========================
//          NRF
// ===========================
const uint64_t pipe = NRF_PIPE;
RF24 radio(NRF_CE_PIN,NRF_CSN_PIN);
int nrf_time = 1000;
double prev_temperature = temperature;
int recv_no_data_cnt = 0;

void nrf_setup()
{  
    radio.begin();                          // Setup and configure rf radio
    radio.setChannel(NRF_CHANNEL);
    radio.setPALevel(NRF_PA_LEVEL);
    radio.setDataRate(NRF_RATE);
    radio.openReadingPipe(1,pipe);
    radio.setAutoAck(1);                    // Ensure autoACK is enabled
    //radio.setRetries(2,15);               // Optionally, increase the delay between retries & # of retries
    radio.startListening();
    radio.powerUp();                        //Power up the radio
}

void nrf_loop(unsigned int delta_time)
{
    nrf_time+=delta_time;
    if (nrf_time<NRF_RECV_TIME_MS) return;
    nrf_time = 0;

    if (radio.available())
    {
        prev_temperature = temperature;
        while(radio.available())
        {
            double data[2];
            radio.read(data, sizeof(data));
            temperature = data[0];
            humidity = data[1];
        }
        recv_success_cnt++;
        recv_no_data_cnt = 0;
        recv_state = RECV_STATE_SUCCESS;

        if (prev_temperature < temperature)
        {
            temperature_state = TEMPERATURE_STATE_UP;
        }
        if (prev_temperature > temperature)
        {
            temperature_state = TEMPERATURE_STATE_DOWN;  
        }
        if (prev_temperature == temperature)
        {
            temperature_state = TEMPERATURE_STATE_NOT_CHANGED;
        }

    }
    else
    {
        recv_no_data_cnt++;
        if (recv_no_data_cnt >= MAX_NO_DATA_BEFORE_ERROR)
        {
            recv_state = RECV_STATE_ERROR;
            recv_error_cnt++;
        }
        
    }

    
}

// ===========================
//	 		MAIN
// ===========================

unsigned long prev_time;

void setup() 
{
    prev_time = millis();
    serial_setup();
    display_setup();
    led_setup();
    nrf_setup();
    

}

void loop() 
{
    unsigned long current_time = millis();

    // if overflow ~ 56 days
    if (current_time < prev_time) prev_time = current_time;

    unsigned int delta_time = current_time - prev_time;
    prev_time = current_time;

    nrf_loop(delta_time);
    led_loop(delta_time);
    display_loop(delta_time);
    serial_loop(delta_time);


}
